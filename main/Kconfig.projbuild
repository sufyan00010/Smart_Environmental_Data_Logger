## main/Kconfig.projbuild
```kconfig
menu "Smart Environmental Logger Configuration"

    config ENABLE_SENSOR_DEBUG
        bool "Enable sensor debug logging"
        default y
        help
            Enable detailed logging for DHT11 and LDR sensors

    config ENABLE_CLOUD_DEBUG
        bool "Enable cloud debug logging"
        default y
        help
            Enable detailed logging for RainMaker cloud communication

    config DHT11_GPIO
        int "DHT11 Data GPIO"
        default 4
        range 0 21
        help
            GPIO pin connected to DHT11 data line (Mapped to Pin D2)

    config LDR_GPIO
        int "LDR ADC GPIO"
        default 3
        range 0 5
        help
            GPIO pin connected to LDR via ADC (Mapped to Pin D1 - ADC1_CH3)

    config OLED_SDA_GPIO
        int "OLED SDA GPIO"
        default 6
        range 0 21
        help
            GPIO pin for OLED I2C SDA line (Mapped to Pin D4)

    config OLED_SCL_GPIO
        int "OLED SCL GPIO"
        default 7
        range 0 21
        help
            GPIO pin for OLED I2C SCL line (Mapped to Pin D5)

    # ... (Keep the rest of your timing/threshold configs the same) ...
    config SENSOR_READ_INTERVAL_SEC
        int "Sensor reading interval (seconds)"
        default 10
        range 5 60

    config TEMP_HIGH_THRESHOLD
        int "High temperature alert threshold (°C)"
        default 35
        range 25 50

    config TEMP_LOW_THRESHOLD
        int "Low temperature alert threshold (°C)"
        default 15
        range 0 25

endmenu
```

## sdkconfig.defaults
```kconfig
# ESP32-C3 Configuration
CONFIG_IDF_TARGET="esp32c3"

# Partition Table
CONFIG_PARTITION_TABLE_CUSTOM=y
CONFIG_PARTITION_TABLE_CUSTOM_FILENAME="partitions.csv"
CONFIG_PARTITION_TABLE_FILENAME="partitions.csv"

# Serial flasher config
CONFIG_ESPTOOLPY_FLASHSIZE_4MB=y
CONFIG_ESPTOOLPY_FLASHSIZE="4MB"

# Compiler options
CONFIG_COMPILER_OPTIMIZATION_SIZE=y
CONFIG_COMPILER_OPTIMIZATION_ASSERTIONS_ENABLE=y

# FreeRTOS
CONFIG_FREERTOS_HZ=1000
CONFIG_FREERTOS_UNICORE=n
CONFIG_FREERTOS_USE_TRACE_FACILITY=y
CONFIG_FREERTOS_USE_STATS_FORMATTING_FUNCTIONS=y
CONFIG_FREERTOS_GENERATE_RUN_TIME_STATS=y

# Log output
CONFIG_LOG_DEFAULT_LEVEL_INFO=y
CONFIG_LOG_MAXIMUM_LEVEL_VERBOSE=y

# Wi-Fi
CONFIG_ESP32_WIFI_STATIC_RX_BUFFER_NUM=10
CONFIG_ESP32_WIFI_DYNAMIC_RX_BUFFER_NUM=32
CONFIG_ESP32_WIFI_DYNAMIC_TX_BUFFER_NUM=32
CONFIG_ESP32_WIFI_AMPDU_TX_ENABLED=y
CONFIG_ESP32_WIFI_AMPDU_RX_ENABLED=y

# LWIP
CONFIG_LWIP_LOCAL_HOSTNAME="smart-env-logger"

# ESP RainMaker
CONFIG_ESP_RMAKER_WORK_QUEUE_TASK_STACK=4096
CONFIG_ESP_RMAKER_FACTORY_PARTITION_NAME="fctry"
CONFIG_ESP_RMAKER_DEF_TIMEZONE="UTC"

# ESP Insights
CONFIG_ESP_INSIGHTS_ENABLED=y
CONFIG_ESP_INSIGHTS_TRANSPORT_HTTPS=y
CONFIG_DIAG_ENABLE_HEAP_METRICS=y
CONFIG_DIAG_ENABLE_WIFI_METRICS=y
CONFIG_DIAG_ENABLE_VARIABLES=y
CONFIG_DIAG_ENABLE_METRICS=y

# MQTT
CONFIG_MQTT_PROTOCOL_311=y
CONFIG_MQTT_TRANSPORT_SSL=y
CONFIG_MQTT_TRANSPORT_WEBSOCKET=y
CONFIG_MQTT_TRANSPORT_WEBSOCKET_SECURE=y

# HTTP Client
CONFIG_ESP_TLS_INSECURE=y
CONFIG_ESP_TLS_SKIP_SERVER_CERT_VERIFY=y

# Bootloader
CONFIG_BOOTLOADER_APP_ROLLBACK_ENABLE=y

# App update
CONFIG_APP_ROLLBACK_ENABLE=y
CONFIG_APP_ANTI_ROLLBACK=n

# ESP System Settings
CONFIG_ESP_TASK_WDT=y
CONFIG_ESP_TASK_WDT_TIMEOUT_S=10
CONFIG_ESP_MAIN_TASK_STACK_SIZE=4096

# Enable ADC calibration
CONFIG_ADC_CAL_EFUSE_TP_ENABLE=y
CONFIG_ADC_CAL_EFUSE_VREF_ENABLE=y
```
